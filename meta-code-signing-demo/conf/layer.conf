## meta-code-signing-demo/conf/layer.conf
```bitbake
# We have a conf and classes directory, add to BBPATH
BBPATH .= ":${LAYERDIR}"

# We have recipes-* directories, add to BBFILES
BBFILES += "${LAYERDIR}/recipes-*/*/*.bb \
            ${LAYERDIR}/recipes-*/*/*.bbappend"

BBFILE_COLLECTIONS += "code-signing-demo"
BBFILE_PATTERN_code-signing-demo = "^${LAYERDIR}/"
BBFILE_PRIORITY_code-signing-demo = "6"

LAYERDEPENDS_code-signing-demo = "core code-signing ptx rauc"
LAYERSERIES_COMPAT_code-signing-demo = "mickledore"
```

## meta-code-signing/conf/layer.conf
```bitbake
# We have a conf and classes directory, add to BBPATH
BBPATH .= ":${LAYERDIR}"

# We have recipes-* directories, add to BBFILES
BBFILES += "${LAYERDIR}/recipes-*/*/*.bb \
            ${LAYERDIR}/recipes-*/*/*.bbappend"

BBFILE_COLLECTIONS += "code-signing"
BBFILE_PATTERN_code-signing = "^${LAYERDIR}/"
BBFILE_PRIORITY_code-signing = "6"

LAYERDEPENDS_code-signing = "core openembedded-layer"
LAYERSERIES_COMPAT_code-signing = "mickledore"
```
